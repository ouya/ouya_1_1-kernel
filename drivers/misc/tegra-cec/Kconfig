## drivers/misc/tegra-cec/Kconfig
```kconfig
menuconfig TEGRA_CEC_SUPPORT
	bool "Tegra CEC support"
	default y
	depends on ARCH_TEGRA
	---help---
	  Say Y here to get to see options for tegra CEC support.
	  This option alone does not add any kernel code.

	  If you say N, all options in this submenu will be skipped and disabled.

if TEGRA_CEC_SUPPORT

config TEGRA_CEC_T30
	bool "Enable T30 CEC support"
	default y
	---help---
	 Adds HDMI-CEC driver for T30.

	 Enabled by default. Choose N here if you dont want to build the driver.

endif # TEGRA_CEC_SUPPORT
```

## drivers/net/wireless/bcm43xx/Kconfig
```kconfig
config BCM43XX
	tristate "Broadcom 4329/30 wireless cards support"
	depends on MMC
	---help---
	  This module adds support for wireless adapters based on
	  Broadcom 4329/30 chipset.

	  This driver uses the kernel's wireless extensions subsystem.

	  If you choose to build a module, it'll be called dhd. Say M if
	  unsure.

config BCM43XX_FW_PATH
	depends on BCM43XX
	string "Firmware path"
	default "/system/vendor/firmware/fw_bcmdhd.bin"
	---help---
	  Path to the firmware file.

config BCM43XX_NVRAM_PATH
	depends on BCM43XX
	string "NVRAM path"
	default "/system/etc/wifi/bcmdhd.cal"
	---help---
	  Path to the calibration file.

choice
	prompt "Select API"
	depends on BCM43XX
	default BCM43XX_NOAPI

config BCM43XX_WEXT
	bool "Enable WEXT support"
	select WIRELESS_EXT
	select WEXT_PRIV
	help
	  Enables WEXT support

config BCM43XX_CFG80211
	bool "Enable CFG80211 support"
	depends on CFG80211
	help
	  Enables CFG80211 support

config BCM43XX_NOAPI
	bool "No wireless API"
	help
	  No wireless API is needed

endchoice

config DHD_USE_STATIC_BUF
	bool "Enable memory preallocation"
	depends on BCM43XX
	default n
	---help---
	  Use memory preallocated in platform

config DHD_USE_SCHED_SCAN
	bool "Use CFG80211 sched scan"
	depends on BCM43XX && CFG80211
	default n
	---help---
	  Use CFG80211 sched scan

config BCM43XX_WIFI_CONTROL_FUNC
	bool "Use bcmdhd_wlan device"
	depends on BCM43XX
	default n
	---help---
	  Use this option to get various parameters from architecture specific
	  bcmdhd_wlan platform device. Say n if unsure.

config BCM43XX_HW_OOB
	bool "Use out of band interrupt"
	depends on BCM43XX
	default n
	---help---
	  Use out of band interrupt for card interrupt and wake on wireless.

config BCM43XX_CSCAN_ENABLE
	bool "Enable Combo Scan"
	depends on BCM43XX
	default n
	---help---
	Enable Combo Scan

config BCM43XX_INSMOD_NO_FW_LOAD
	bool "Enable delayed firmware load"
	depends on BCM43XX
	default n
	---help---
	Enable delayes firmware

config BCM43XX_CUSTOM_REGULATORY_DOMAIN
	bool "Enable Custom Regulatory Domain"
	depends on BCM43XX
	default y
	---help---
	Use Custom Regulatory Domain set by driver.
```
